## main/Kconfig.projbuild
```kconfig
menu "Snapserver Mesh Project Configuration"

config SNAPSERVER_STATUS_LED_ENABLE
    bool "Status LED (on-board WS2812)"
    default y
    help
        Drives a single on-board WS2812 as a combined indicator: colour
        shows what the device is doing (red = no network, orange = network
        but no Snapserver, green = playing, cyan = local input, blue =
        provisioning AP), brightness follows the audio level.

        Costs one RMT channel and a task that sleeps 33 ms between 24-bit
        transfers. The level comes from measurements the audio path already
        makes, so nothing is computed twice for it.

config SNAPSERVER_STATUS_LED_GPIO
    int "Status LED GPIO"
    default 48
    range 0 48
    depends on SNAPSERVER_STATUS_LED_ENABLE
    help
        Data pin of the on-board WS2812. Boards differ: 48 on the widely
        sold "ESP32-S3 Super Mini", 21 on the S3-Zero style boards, 47 on
        the Lolin S3 Mini.

        To find out which one applies, just flash: the LED flashes red,
        green and blue once at startup. If it stays dark, the pin is wrong
        -- try the other values above.

config SNAPSERVER_POTS_ENABLE
    bool "Potentiometer inputs (volume, delay)"
    default y
    help
        Up to two 10 kOhm potentiometers on ADC1: one sets the volume of
        this device's own speaker, the other its delay trim. Neither
        touches the stream a server sends to its clients.

        Which pins, if any, is chosen on the web config page, not here --
        the page only offers pins that are free: ADC1 (GPIO 1-10, since
        ADC2 cannot be read while Wi-Fi runs), minus the I2S pins in
        audio_i2s.h, the strapping pin 3 and the status LED.

        Out of the box the volume knob is on GPIO 10 and the delay knob is
        off. An unconnected volume pin reads full scale, so boards with no
        knob play at full volume. Turning this off removes the ADC code
        entirely; volume is then fixed at 100 % and the delay trim comes
        from the config page.

config SNAPSERVER_ENABLE_MESH_LITE
    bool "Enable ESP-Mesh-Lite"
    default n
    help
        Build-time capability switch: whether this firmware image includes
        ESP-Mesh-Lite support at all. Whether mesh is actually active on a
        given device is a separate, runtime setting stored in NVS and
        edited via the web config page; if this is off, that runtime
        setting has no effect and the device always falls back to the
        open provisioning AP, since no other network mode is compiled in.

config MESH_SOFTAP_SSID_PREFIX
    string "Mesh-Lite SoftAP SSID prefix"
    default "SnapMesh"
    depends on SNAPSERVER_ENABLE_MESH_LITE
    help
        First-boot / factory-reset default only. Once a device has booted
        once, the mesh SSID lives in NVS and is edited via the web config
        page, not here; this value only seeds a fresh device.
        Must match across all mesh nodes (root and clients) for a given
        mesh network.

config MESH_SOFTAP_PASSWORD
    string "Mesh-Lite SoftAP password"
    default "criticalmass"
    depends on SNAPSERVER_ENABLE_MESH_LITE
    help
        First-boot / factory-reset default only (see MESH_SOFTAP_SSID_PREFIX).
        SoftAP-Passwort, das alle Mesh-Knoten teilen. Muss auf Root und
        jedem Client identisch sein, sonst scheitern Kinder mit
        WiFi reason 210/15 (security mismatch / handshake timeout).

config MESH_CHANNEL
    int "Mesh Wi-Fi channel"
    default 6
    range 1 13
    depends on SNAPSERVER_ENABLE_MESH_LITE
    help
        First-boot / factory-reset default only (see MESH_SOFTAP_SSID_PREFIX).
        Fester 2.4-GHz-WLAN-Kanal des autarken Mesh-Netzes.
        Root und alle Clients muessen denselben Kanal verwenden.

config SNAPSERVER_OPUS_BITRATE
    int "Opus bitrate (bit/s)"
    default 96000
    range 16000 192000
    help
        First-boot / factory-reset default only; editable live afterwards
        via the web config page without a reboot.

config SNAPSERVER_OPUS_COMPLEXITY
    int "Opus encoder complexity"
    default 5
    range 0 10
    help
        First-boot / factory-reset default only; editable live afterwards
        via the web config page without a reboot.

config SNAPSERVER_CROSSOVER_HZ
    int "LR4 crossover frequency (Hz)"
    default 120
    range 40 500
    help
        First-boot / factory-reset default only; editable live afterwards
        via the web config page without a reboot.
        Trennfrequenz der Linkwitz-Riley-Frequenzweiche (4. Ordnung).
        sub = Tiefpass unterhalb, wideband = Hochpass oberhalb.

endmenu
```
